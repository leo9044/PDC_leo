## meta/meta-headunit/conf/layer.conf
```bitbake
# Layer configuration for meta-headunit
# This layer provides automotive head unit applications for ECU2 main display (HDMI-1)
BBPATH .= ":${LAYERDIR}"

# We have a conf and classes directory, add to BBPATH
BBPATH .= ":${LAYERDIR}"

# We have recipe directories, add to BBFILES
BBFILES += "${LAYERDIR}/recipes-*/*/*.bb \
            ${LAYERDIR}/recipes-*/*/*.bbappend"

# Layer identification and priority
BBFILE_COLLECTIONS += "meta-headunit"
BBFILE_PATTERN_meta-headunit = "^${LAYERDIR}/"

# CRITICAL: Priority set to 15 to ensure meta-headunit recipes take precedence
# over recipes from meta-openembedded, meta-qt5, and other layers (priority <= 10)
BBFILE_PRIORITY_meta-headunit = "15"

# Layer dependencies
LAYERDEPENDS_meta-headunit = "core meta-middleware"

# Yocto series compatibility - supports current and future LTS releases
LAYERSERIES_COMPAT_meta-headunit = "kirkstone langdale mickledore nanbield scarthgap"
```

## meta/meta-instrumentcluster/conf/layer.conf
```bitbake
# Layer configuration for meta-instrumentcluster
# This layer provides instrument cluster application for ECU2 secondary display
BBPATH .= ":${LAYERDIR}"

# We have a conf and classes directory, add to BBPATH
BBPATH .= ":${LAYERDIR}"

# We have recipe directories, add to BBFILES
BBFILES += "${LAYERDIR}/recipes-*/*/*.bb \
            ${LAYERDIR}/recipes-*/*/*.bbappend"

# Layer identification and priority
BBFILE_COLLECTIONS += "meta-instrumentcluster"
BBFILE_PATTERN_meta-instrumentcluster = "^${LAYERDIR}/"

# Priority set to 12 (application layer)
BBFILE_PRIORITY_meta-instrumentcluster = "12"

# Layer dependencies
LAYERDEPENDS_meta-instrumentcluster = "core meta-middleware"

# Yocto series compatibility
LAYERSERIES_COMPAT_meta-instrumentcluster = "kirkstone langdale mickledore nanbield scarthgap"
```

## meta/meta-instrumentcluster/conf/machine/raspberrypi4-64.conf
```bitbake
# Add Waveshare DSI panel overlay to kernel build
# This ensures the vc4-kms-dsi-waveshare-panel.dtbo overlay is compiled and deployed
RPI_KERNEL_DEVICETREE_OVERLAYS:append = " \
    overlays/vc4-kms-dsi-waveshare-panel.dtbo \
"
```
